AUTOSAR XML
package /Demo
  swc Power: version=1
