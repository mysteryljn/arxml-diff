AUTOSAR XML
package /Demo
  swc Power: version=2
  swc Body: version=1
